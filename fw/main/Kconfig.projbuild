## fw/main/Kconfig.projbuild
```kconfig
menu "Pressure sensor"
config HPS_DEBUG_CONSOLE
    bool "Serial hardware test console (bench firmware only)"
    default n
    help
        Enables explicit serial debug commands. Normal firmware excludes these.
endmenu
```

## fw/sdkconfig.defaults
```kconfig
CONFIG_IDF_TARGET="esp32"
CONFIG_ESPTOOLPY_FLASHSIZE_4MB=y
CONFIG_PARTITION_TABLE_CUSTOM=y
CONFIG_PARTITION_TABLE_CUSTOM_FILENAME="partitions.csv"
CONFIG_BT_ENABLED=y
CONFIG_BT_NIMBLE_ENABLED=y
CONFIG_BT_NIMBLE_MAX_CONNECTIONS=1
CONFIG_BT_NIMBLE_MAX_BONDS=4
CONFIG_BT_NIMBLE_SM_SC=y
CONFIG_BT_NIMBLE_SM_LEGACY=n
CONFIG_BT_NIMBLE_NVS_PERSIST=y
CONFIG_BT_NIMBLE_ATT_PREFERRED_MTU=247
CONFIG_BT_NIMBLE_HOST_TASK_STACK_SIZE=6144
CONFIG_COMPILER_CXX_EXCEPTIONS=n
CONFIG_FATFS_LFN_STACK=y
CONFIG_FATFS_MAX_LFN=96
CONFIG_ESP_MAIN_TASK_STACK_SIZE=8192
CONFIG_LOG_DEFAULT_LEVEL_WARN=y
```
